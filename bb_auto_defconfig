## bb_auto_defconfig
```kconfig
BR2_arm=y
BR2_cortex_a8=y
BR2_TOOLCHAIN_EXTERNAL=y
BR2_TOOLCHAIN_EXTERNAL_CUSTOM=y
BR2_TOOLCHAIN_EXTERNAL_PATH="$(HOME)/toolchain"
BR2_TOOLCHAIN_EXTERNAL_CUSTOM_PREFIX="$(ARCH)-none-linux-gnueabihf"
BR2_TOOLCHAIN_EXTERNAL_GCC_10=y
BR2_TOOLCHAIN_EXTERNAL_HEADERS_4_20=y
BR2_TOOLCHAIN_EXTERNAL_CUSTOM_GLIBC=y
BR2_TOOLCHAIN_EXTERNAL_CXX=y
BR2_TARGET_GENERIC_HOSTNAME="bb_auto"
BR2_TARGET_GENERIC_ISSUE="Welcome to the car"
BR2_INIT_SYSTEMD=y
BR2_TARGET_GENERIC_ROOT_PASSWD="balrog"
BR2_SYSTEM_BIN_SH_BASH=y
BR2_SYSTEM_DEFAULT_PATH="/usr/bin:/usr/sbin:/opt:/opt/bin"
BR2_ROOTFS_USERS_TABLES="board/beaglebone_auto/users.txt"
BR2_ROOTFS_OVERLAY="board/beaglebone_auto/rootfs_overlay"
BR2_ROOTFS_POST_BUILD_SCRIPT="board/beaglebone_auto/post-build.sh"
BR2_LINUX_KERNEL=y
BR2_LINUX_KERNEL_CUSTOM_GIT=y
BR2_LINUX_KERNEL_CUSTOM_REPO_URL="https://github.com/beagleboard/linux.git"
BR2_LINUX_KERNEL_CUSTOM_REPO_VERSION="5.4"
BR2_LINUX_KERNEL_DEFCONFIG="omap2plus"
BR2_LINUX_KERNEL_DTS_SUPPORT=y
BR2_LINUX_KERNEL_INTREE_DTS_NAME="am335x-boneblack am335x-boneblack-wireless"
BR2_LINUX_KERNEL_DTB_OVERLAY_SUPPORT=y
BR2_LINUX_KERNEL_NEEDS_HOST_OPENSSL=y
BR2_PACKAGE_LINUX_TOOLS_CPUPOWER=y
BR2_PACKAGE_LINUX_TOOLS_GPIO=y
BR2_PACKAGE_MTD=y
BR2_PACKAGE_DEJAVU=y
BR2_PACKAGE_LIBERATION=y
BR2_PACKAGE_XORG7=y
BR2_PACKAGE_XSERVER_XORG_SERVER=y
BR2_PACKAGE_XLIB_LIBXFONT=y
BR2_PACKAGE_XAPP_XCLOCK=y
BR2_PACKAGE_XAPP_XHOST=y
BR2_PACKAGE_XAPP_XINIT=y
BR2_PACKAGE_XAPP_XSETROOT=y
BR2_PACKAGE_XDRIVER_XF86_INPUT_EVDEV=y
BR2_PACKAGE_XDRIVER_XF86_INPUT_KEYBOARD=y
BR2_PACKAGE_XDRIVER_XF86_INPUT_MOUSE=y
BR2_PACKAGE_XDRIVER_XF86_VIDEO_FBDEV=y
BR2_PACKAGE_XFONT_FONT_BH_TTF=y
BR2_PACKAGE_LEAFPAD=y
BR2_PACKAGE_XSCREENSAVER=y
BR2_PACKAGE_XTERM=y
BR2_PACKAGE_OPENBOX=y
BR2_PACKAGE_AM33X_CM3=y
BR2_PACKAGE_LINUX_FIRMWARE=y
BR2_PACKAGE_LINUX_FIRMWARE_TI_WL18XX=y
BR2_PACKAGE_WILINK_BT_FIRMWARE=y
BR2_PACKAGE_18XX_TI_UTILS=y
BR2_PACKAGE_AM335X_PRU_PACKAGE=y
BR2_PACKAGE_GPSD=y
BR2_PACKAGE_GPSD_DEVICES="/dev/ttyS4"
BR2_PACKAGE_GPSD_USER=y
BR2_PACKAGE_GPSD_USER_VALUE="root"
BR2_PACKAGE_GPSD_GROUP=y
BR2_PACKAGE_GPSD_GROUP_VALUE="root"
BR2_PACKAGE_GPSD_PYTHON=y
BR2_PACKAGE_GPSD_UBX=y
BR2_PACKAGE_LIBUIO=y
BR2_PACKAGE_SPI_TOOLS=y
BR2_PACKAGE_TIO=y
BR2_PACKAGE_PYTHON_CANOPEN=y
BR2_PACKAGE_PYTHON_CRC16=y
BR2_PACKAGE_PYTHON_GOBJECT=y
BR2_PACKAGE_PYTHON_PIP=y
BR2_PACKAGE_PYTHON_PYCAIRO=y
BR2_PACKAGE_PYTHON_PYMODBUS=y
BR2_PACKAGE_CAIRO_SCRIPT=y
BR2_PACKAGE_GIBLIB=y
BR2_PACKAGE_LIBDRM_OMAP=y
BR2_PACKAGE_WAYLAND=y
BR2_PACKAGE_LIBUSB=y
BR2_PACKAGE_LIBXKBCOMMON=y
BR2_PACKAGE_GLIBMM=y
BR2_PACKAGE_PCRE2=y
BR2_PACKAGE_PCRE2_16=y
BR2_PACKAGE_BLUEZ_TOOLS=y
BR2_PACKAGE_BLUEZ5_UTILS=y
BR2_PACKAGE_BLUEZ5_UTILS_OBEX=y
BR2_PACKAGE_BLUEZ5_UTILS_CLIENT=y
BR2_PACKAGE_BLUEZ5_UTILS_MONITOR=y
BR2_PACKAGE_BLUEZ5_UTILS_PLUGINS_AUDIO=y
BR2_PACKAGE_BLUEZ5_UTILS_PLUGINS_MIDI=y
BR2_PACKAGE_BLUEZ5_UTILS_TOOLS_HID2HCI=y
BR2_PACKAGE_CONNMAN=y
# BR2_PACKAGE_CONNMAN_ETHERNET is not set
BR2_PACKAGE_CONNMAN_WIFI=y
BR2_PACKAGE_CONNMAN_BLUETOOTH=y
BR2_PACKAGE_CONNMAN_LOOPBACK=y
BR2_PACKAGE_CONNMAN_CLIENT=y
BR2_PACKAGE_DHCP=y
BR2_PACKAGE_DHCP_CLIENT=y
BR2_PACKAGE_MOSQUITTO=y
# BR2_PACKAGE_MOSQUITTO_BROKER is not set
BR2_PACKAGE_NET_TOOLS=y
BR2_PACKAGE_OPENSSH=y
BR2_PACKAGE_WGET=y
BR2_PACKAGE_WIRELESS_TOOLS=y
BR2_PACKAGE_WIRELESS_TOOLS_LIB=y
BR2_PACKAGE_WPA_SUPPLICANT_AP_SUPPORT=y
BR2_PACKAGE_WPA_SUPPLICANT_WIFI_DISPLAY=y
BR2_PACKAGE_WPA_SUPPLICANT_WPA3=y
BR2_PACKAGE_WPA_SUPPLICANT_CLI=y
BR2_PACKAGE_WPA_SUPPLICANT_WPA_CLIENT_SO=y
BR2_PACKAGE_SUDO=y
BR2_PACKAGE_HTOP=y
BR2_PACKAGE_SYSTEMD_RFKILL=y
BR2_PACKAGE_UTIL_LINUX_RFKILL=y
BR2_PACKAGE_NANO=y
BR2_TARGET_ROOTFS_EXT2=y
BR2_TARGET_ROOTFS_EXT2_4=y
BR2_TARGET_ROOTFS_EXT2_SIZE="500M"
BR2_TARGET_UBOOT=y
BR2_TARGET_UBOOT_BUILD_SYSTEM_KCONFIG=y
BR2_TARGET_UBOOT_CUSTOM_VERSION=y
BR2_TARGET_UBOOT_CUSTOM_VERSION_VALUE="2021.04"
BR2_TARGET_UBOOT_BOARD_DEFCONFIG="am335x_evm"
BR2_TARGET_UBOOT_NEEDS_DTC=y
# BR2_TARGET_UBOOT_FORMAT_BIN is not set
BR2_TARGET_UBOOT_FORMAT_IMG=y
BR2_TARGET_UBOOT_SPL=y
BR2_TARGET_UBOOT_SPL_NAME="MLO"
BR2_PACKAGE_HOST_PKGCONF=y
BR2_PACKAGE_HOST_PRU_SOFTWARE_SUPPORT=y
BR2_PACKAGE_HOST_PYTHON3=y
BR2_PACKAGE_HOST_RUSTC=y
```

## beaglebone_auto/bb_fit_img_source.its
```
/dts-v1/;

/ {
        description = "BeagleBone Black FIT Image";
        #address-cells = <1>;

        images {
                kernel {
                        description = "Kernel";
                        data = /incbin/("./../../output/images/zImage");
                        type = "kernel";
                        arch = "ARM";
                        os = "linux";
                        compression = "none";
                        load = <0x81000000>;
                        entry = <0x81000000>;
                        hash {
                                algo = "sha1";
                        };
                };
                fdt {
                        description = "DTB";
                        data = /incbin/("./../../output/images/am335x-boneblack.dtb");
                        type = "flat_dt";
                        arch = "ARM";
                        compression = "none";
                        load = <0x82000000>;
                        entry = <0x82000000>;
                        hash {
                                algo = "sha1";
                        };
                };
                fdt_wireless {
                	description = "DTB";
                        data = /incbin/("./../../output/images/am335x-boneblack-wireless.dtb");
                        type = "flat_dt";
                        arch = "ARM";
                        compression = "none";
                        load = <0x82000000>;
                        entry = <0x82000000>;
                        hash {
                                algo = "sha1";
                        };
                };
                fdt_uart {
                	description = "UART4";
                	type = "flat_dt";
                	arch = "ARM";
                	data = /incbin/("./../../output/images/BB-UART4-00A0.dtb");
                	compression = "none";
                        load = <0x83000000>;
                        entry = <0x83000000>;
                        hash {
                                algo = "sha1";
                        };
                };
        };

        configurations {
                default = "standard";
                standard {
                        description = "Standard Boot";
                        kernel = "kernel";
                        fdt = "fdt", "fdt_uart";
                        hash {
                                algo = "sha1";
                        };
                };
                wireless {
                	description = "Wireless Boot";
                        kernel = "kernel";
                        fdt = "fdt_wireless", "fdt_uart";
                        hash {
                                algo = "sha1";
                        };
                };
        };

};              
```
